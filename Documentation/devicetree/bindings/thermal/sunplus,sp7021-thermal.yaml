## Documentation/devicetree/bindings/thermal/sunplus,sp7021-thermal.yaml
```yaml
# SPDX-License-Identifier: (GPL-2.0-only OR BSD-2-Clause)
%YAML 1.2
---
$id: http://devicetree.org/schemas/thermal/sunplus,sp7021-thermal.yaml#
$schema: http://devicetree.org/meta-schemas/core.yaml#

title: Sunplus SP7021 SoC thermal sensor

maintainers:
  - Andrew Gaylard <andrew@figment.co.za>

description:
  The SP7021 contains an on-chip thermal sensor that measures die
  temperature. A factory-programmed calibration value stored in OTP
  is used to correct the raw ADC reading.

allOf:
  - $ref: thermal-sensor.yaml#

properties:
  compatible:
    const: sunplus,sp7021-thermal

  reg:
    maxItems: 1

  '#thermal-sensor-cells':
    const: 0

  nvmem-cells:
    maxItems: 1

  nvmem-cell-names:
    items:
      - const: therm_calib

required:
  - compatible
  - reg
  - '#thermal-sensor-cells'

unevaluatedProperties: false

examples:
  - |
    thermal: thermal@280 {
        compatible = "sunplus,sp7021-thermal";
        reg = <0x280 0x80>;
        '#thermal-sensor-cells' = <0>;
        nvmem-cell-names = "therm_calib";
        nvmem-cells = <&therm_calib>;
    };
```

## arch/arm/configs/sp7021_fdl_defconfig
```kconfig
CONFIG_SYSVIPC=y
CONFIG_NO_HZ_IDLE=y
CONFIG_HIGH_RES_TIMERS=y
CONFIG_PREEMPT=y
CONFIG_IKCONFIG=y
CONFIG_IKCONFIG_PROC=y
CONFIG_LOG_BUF_SHIFT=14
CONFIG_BLK_DEV_INITRD=y
# CONFIG_RD_GZIP is not set
# CONFIG_RD_BZIP2 is not set
# CONFIG_RD_LZMA is not set
# CONFIG_RD_XZ is not set
# CONFIG_RD_LZO is not set
# CONFIG_RD_LZ4 is not set
CONFIG_CC_OPTIMIZE_FOR_SIZE=y
CONFIG_PERF_EVENTS=y
CONFIG_ARCH_SUNPLUS=y
# CONFIG_VDSO is not set
CONFIG_ARM_ERRATA_814220=y
CONFIG_SMP=y
CONFIG_ARCH_FORCE_MAX_ORDER=11
CONFIG_CMDLINE="clk_ignore_unused"
CONFIG_CMDLINE_EXTEND=y
CONFIG_VFP=y
CONFIG_NEON=y
CONFIG_MODULES=y
CONFIG_MODULE_UNLOAD=y
CONFIG_MODVERSIONS=y
# CONFIG_IOSCHED_BFQ is not set
# CONFIG_CORE_DUMP_DEFAULT_ELF_HEADERS is not set
CONFIG_EXPERT=y
CONFIG_DEVMEM=y
CONFIG_THERMAL=y
CONFIG_THERMAL_HWMON=y
CONFIG_SP7021_THERMAL=y
CONFIG_NET=y
CONFIG_UNIX=y
CONFIG_INET=y
CONFIG_SYN_COOKIES=y
CONFIG_UEVENT_HELPER=y
CONFIG_UEVENT_HELPER_PATH="/sbin/hotplug"
CONFIG_DEVTMPFS=y
CONFIG_DEVTMPFS_MOUNT=y
CONFIG_BLK_DEV_LOOP=y
CONFIG_NETDEVICES=y
CONFIG_SP7021_EMAC=y
CONFIG_INPUT_SPARSEKMAP=y
CONFIG_INPUT_EVDEV=y
# CONFIG_INPUT_KEYBOARD is not set
# CONFIG_INPUT_MOUSE is not set
# CONFIG_LEGACY_PTYS is not set
# CONFIG_HW_RANDOM is not set
# CONFIG_PTP_1588_CLOCK is not set
CONFIG_HWMON=y
CONFIG_USB=y
CONFIG_USB_EHCI_HCD=y
CONFIG_USB_EHCI_SP7021=y
CONFIG_USB_OHCI_HCD=y
CONFIG_USB_OHCI_SP7021=y
CONFIG_PHY_SUNPLUS_USB=y
CONFIG_USB_STORAGE=y
CONFIG_USB_SERIAL=y
CONFIG_USB_SERIAL_OPTION=y
CONFIG_SCSI=y
CONFIG_BLK_DEV_SD=y
CONFIG_SPI=y
CONFIG_SPI_SUNPLUS_SP7021=y
CONFIG_SPI_SPIDEV=y
CONFIG_I2C=y
CONFIG_I2C_SP7021=y
CONFIG_I2C_CHARDEV=y
CONFIG_EEPROM_AT24=y
CONFIG_MMC=y
CONFIG_MMC_SUNPLUS=y
CONFIG_MMC_SUNPLUS_SD=y
CONFIG_WATCHDOG=y
CONFIG_WATCHDOG_SYSFS=y
CONFIG_SUNPLUS_WATCHDOG=y
CONFIG_RTC_CLASS=y
CONFIG_RTC_DRV_SUNPLUS=y
CONFIG_NVMEM=y
CONFIG_NVMEM_SUNPLUS_OCOTP=y
CONFIG_GPIO_SYSFS=y
CONFIG_NEW_LEDS=y
CONFIG_LEDS_CLASS=y
CONFIG_LEDS_GPIO=y
CONFIG_LEDS_TRIGGERS=y
CONFIG_LEDS_TRIGGER_HEARTBEAT=y
# CONFIG_IOMMU_SUPPORT is not set
CONFIG_RESET_CONTROLLER=y
CONFIG_EXT4_FS=y
# CONFIG_DNOTIFY is not set
CONFIG_FANOTIFY=y
CONFIG_VFAT_FS=y
CONFIG_FAT_DEFAULT_IOCHARSET="utf8"
CONFIG_EXFAT_FS=y
CONFIG_TMPFS=y
CONFIG_TMPFS_POSIX_ACL=y
# CONFIG_MISC_FILESYSTEMS is not set
CONFIG_NLS_CODEPAGE_437=y
CONFIG_NLS_ASCII=y
CONFIG_NLS_ISO8859_1=y
CONFIG_NLS_UTF8=y
CONFIG_PRINTK_TIME=y
CONFIG_DYNAMIC_DEBUG=y
CONFIG_MAGIC_SYSRQ=y
CONFIG_DEBUG_FS=y
CONFIG_DEBUG_USER=y
```

## drivers/gpu/drm/sunplus/Kconfig
```kconfig
# SPDX-License-Identifier: GPL-2.0

config DRM_SP7021
	tristate "Sunplus SP7021 DRM display"
	depends on DRM && OF
	select DRM_KMS_HELPER
	select DRM_GEM_DMA_HELPER
	select DRM_DISPLAY_HELPER
	select DRM_BRIDGE_CONNECTOR
	help
	  DRM driver for the SP7021 display pipeline. Drives the OSD0 layer
	  through DMIX and TGEN, attaching to the sp7021-hdmitx bridge for
	  HDMI output. Enables Wayland compositors via DRM/KMS.

config DRM_SP7021_HDMITX
	tristate "Sunplus SP7021 HDMI TX"
	depends on DRM && OF
	select DRM_BRIDGE_CONNECTOR
	select DRM_KMS_HELPER
	help
	  DRM bridge driver for the HDMI transmitter integrated in the
	  Sunplus SP7021 SoC. Supports 480p, 576p, 720p60 and 1080p60
	  output modes with HPD and EDID via the hardware DDC controller.
```

## drivers/misc/sunplus-iop/Kconfig
```kconfig
# SPDX-License-Identifier: GPL-2.0-only

config SUNPLUS_IOP
	tristate "Sunplus SP7021 IOP (8051) support"
	depends on SOC_SP7021 || COMPILE_TEST
	help
	  Driver for the 8051 I/O processor embedded in the Sunplus SP7021
	  SoC.  The IOP manages GPIO state in low-power modes, handles RTC
	  wake-up, and cooperates with the PMC during suspend and power-off.

	  Built-in firmware is loaded into a reserved SRAM region at boot.
	  Replacement firmware can be uploaded at runtime via sysfs.
```
